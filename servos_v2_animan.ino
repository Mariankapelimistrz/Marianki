#include <Servo.h>

//Camera dimensions
#define SCREEN_WIDTH 160
#define SCREEN_HEIGHT 120

//Borders of move
#define MAX_NECK_ROT 16
#define MIN_NECK_ROT -70
#define MAX_UPDOWN 7
#define MIN_UPDOWN -54

//Speed of moving
#define STEP_X 2
#define STEP_Y 1

//Servo pinout
#define SERV_NECK_ROT 2 //11
#define NOT_USED 6
#define SERV_NECK_LEFT 4 //5
#define SERV_NECK_RIGHT 3 //4

//Section definitions
#define LEFT_LIMIT 40
#define RIGHT_LIMIT 55
#define TOP_LIMIT 55
#define BOTTOM_LIMIT 75

int camAX = ((SCREEN_WIDTH/2)-10);
int camBX = ((SCREEN_WIDTH/2)+10);
int camAY = ((SCREEN_HEIGHT/2)-10);
int camBY = ((SCREEN_HEIGHT/2)+10);

int camCenX = int((camBX+camAX)/2);
int camCenY = int((camBY+camAY)/2);

int vectX=0;
int vectY=0;

//const byte FPSA = 24;
//const int FRAMESA = 894;
//const float animAR[FRAMESA] = {
//  
//  46, 46, 46, 46, 46, 46, 46, 46, 46, 46, 46, 46, 46,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 45,
//  45, 45, 45, 45, 45, 45, 45, 45, 45, 45, 45, 45, 45,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 45,
//  45, 45, 45, 45, 45, 45, 45, 45, 45, 45, 45, 45, 45,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 45,
//  45, 45, 45, 45, 45, 45, 45, 45, 45, 45, 45, 45, 45,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 52,
//  52, 52, 52, 53, 53, 53, 54, 54, 54, 54, 55, 55, 55,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 63,
//  63, 63, 63, 63, 63, 63, 63, 63, 63, 63, 63, 63, 63,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 54,
//  53, 53, 53, 52, 52, 52, 51, 51, 51, 50, 50, 50, 49,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 39,
//  38, 38, 38, 38, 38, 38, 37, 37, 37, 37, 37, 37, 37,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 38,
//  39, 39, 39, 39, 39, 39, 40, 40, 40, 40, 41, 41, 41,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 48,
//  48, 49, 49, 49, 49, 49, 49, 49, 49, 49, 49, 49, 49,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 51,
//  51, 51, 51, 51, 51, 51, 51, 51, 51, 51, 51, 51, 51,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 53,
//  53, 53, 53, 54, 54, 54, 54, 54, 54, 54, 54, 54, 54,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 61,
//  61, 61, 61, 62, 62, 62, 62, 63, 63, 63, 63, 64, 64,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 80,
//  80, 80, 81, 81, 81, 81, 81, 81, 81, 81, 81, 81, 81,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 74,
//  74, 74, 73, 73, 73, 73, 72, 72, 72, 72, 72, 71, 71,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 59,
//  59, 59, 58, 58, 58, 58, 57, 57, 57, 57, 57, 57, 57,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 71,
//  71, 72, 72, 72, 72, 73, 73, 73, 73, 73, 73, 73, 73,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 62,
//  61, 61, 60, 60, 59, 59, 58, 58, 57, 56, 56, 55, 55,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 46,
//};

// Servo ID: 1
//const float animAL[FRAMESA] = {
//  124, 124, 124, 124, 124, 124, 124, 124, 124, 124, 125, 125, 125,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 128,
//  128, 128, 128, 128, 128, 128, 128, 129, 129, 129, 129, 129, 129,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 134,
//  134, 134, 135, 135, 135, 135, 135, 135, 135, 135, 135, 136, 136,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 138,
//  138, 138, 138, 138, 138, 138, 138, 138, 138, 138, 138, 138, 138,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 131,
//  130, 130, 130, 129, 129, 129, 128, 128, 128, 127, 127, 127, 126,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 118,
//  118, 118, 117, 117, 117, 117, 117, 118, 118, 118, 118, 118, 118,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 127,
//  127, 128, 128, 129, 129, 129, 130, 130, 130, 131, 131, 131, 132,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 142,
//  143, 143, 143, 143, 143, 144, 144, 144, 144, 144, 144, 144, 144,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 143,
//  143, 142, 142, 142, 142, 142, 141, 141, 141, 141, 141, 140, 140,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 133,
//  133, 132, 132, 132, 132, 132, 132, 132, 132, 132, 132, 132, 132,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 131,
//  131, 131, 131, 131, 131, 131, 131, 131, 131, 131, 131, 131, 131,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 133,
//  133, 133, 133, 133, 134, 134, 134, 134, 134, 134, 134, 134, 134,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 140,
//  140, 140, 140, 140, 140, 141, 141, 141, 141, 142, 142, 142, 143,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 160,
//  160, 160, 160, 160, 160, 160, 160, 160, 160, 160, 160, 160, 160,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 160,
//  160, 160, 160, 160, 160, 160, 160, 160, 160, 160, 160, 160, 160,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 158,
//  157, 156, 156, 155, 154, 153, 153, 152, 151, 150, 149, 148, 147,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 103,
//  102, 102, 101, 100, 100, 99, 99, 99, 99, 98, 98, 98, 98,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 109,
//  110, 110, 111, 111, 112, 112, 113, 113, 114, 114, 115, 115, 116,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 124,};




const byte FPSB = 24;
const int FRAMESB = 509;
const uint8_t animBR[FRAMESB] = { 62, 62, 62, 62, 62, 62, 62, 62, 62, 62, 62, 62, 62,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 64,
  64, 64, 65, 65, 65, 65, 65, 65, 65, 65, 65, 65,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 70,
  70, 70, 71, 71, 71, 71, 71, 71, 71, 72, 72, 72,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 77,
  78, 78, 78, 78, 78, 78, 78, 79, 79, 79, 79, 79,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 84,
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  69, 69, 69, 69, 69, 69, 69, 69, 69,};

// Servo ID: 1
const uint8_t animBL[FRAMESB] = {
  59, 59, 59, 59, 59, 59, 59, 59, 59, 59, 59, 59,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 61,
  61, 61, 61, 61, 61, 62, 62, 62, 62, 62, 62, 62,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 67,
  67, 67, 68, 68, 68, 68, 68, 68, 69, 69, 69, 69,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 75,
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  67, 67, 67, 67, 67, 67, 67, 67, 67,};
const byte FPcB = 24;
const int FRAMESB = 509;
const uint8_t animcR[FRAMESB] = { 62, 62, 62, 62, 62, 62, 62, 62, 62, 62, 62, 62, 62,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 64,
  64, 64, 65, 65, 65, 65, 65, 65, 65, 65, 65, 65,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 70,
  70, 70, 71, 71, 71, 71, 71, 71, 71, 72, 72, 72,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 77,
  78, 78, 78, 78, 78, 78, 78, 79, 79, 79, 79, 79,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 84,
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  69, 69, 69, 69, 69, 69, 69, 69, 69,};

// Servo ID: 1
const uint8_t animcL[FRAMESB] = {
  59, 59, 59, 59, 59, 59, 59, 59, 59, 59, 59, 59,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 61,
  61, 61, 61, 61, 61, 62, 62, 62, 62, 62, 62, 62,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 67,
  67, 67, 68, 68, 68, 68, 68, 68, 69, 69, 69, 69,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 75,
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  67, 67, 67, 67, 67, 67, 67, 67, 67,};

/*
 * Notatka:
 * 
 * Szyja_obr:     120 = 0*    - środek,    75 = 50*    - lewo,  150 = 17*   - prawo
 * Góra dół:      90/100 = 0* - środek,    100/85 = 7* - góra,  10/170 = 54* - dół/smutny marian maks do góry 10*
 * (lewy/prawy)
 * 
 * Sekcje ekranu:
 *  |----|----|----|
 *  | LG | G  | PG |
 *  |----|----|----|
 *  | L  | CEN| P  |
 *  |----|----|----|
 *  | LD | D  | PD |
 *  |----|----|----|
 * 
 */

//Create servo objects
Servo neck_rot;
Servo neck_left;
Servo neck_right;

int neck_rot_ang=0;
int neck_updown_ang=0;

void setup() {
  Serial.begin(9600);
  neck_rot.attach(SERV_NECK_ROT,600,2300);  // (pin, min, max)
  neck_left.attach(SERV_NECK_LEFT,600,2300);  // (pin, min, max)
  neck_right.attach(SERV_NECK_RIGHT,600,2300);  // (pin, min, max)
  setDefaultPose();
}

void loop() {  
  while(1){
    vectX=0;
    vectY=0;
    
    //Serial.println("Enter position:");
    
    //Wait to position
    while (Serial.available() == 0) {}     //wait for data available
    String string = Serial.readStringUntil('\n');  //read until timeout 
    //\n is a last number in string
    //Serial.println(string);
    string.trim();                        // remove any \r \n whitespace at the end of the String

//    if(string.charAt(0)=='a'){
//      startAnimationA();
//    }else  
     if(string.charAt(0)=='b'){
      startAnimationB();
    }else{
      convertToVariablesINT(string);
  
      if(camCenX<LEFT_LIMIT){vectX=STEP_X;}
      if(camCenX>RIGHT_LIMIT){vectX=-STEP_X;}
      if(camCenY<TOP_LIMIT){vectY=STEP_Y;}
      if(camCenY>BOTTOM_LIMIT){vectY=-STEP_Y;}
  
      //Move head
      if(((neck_rot_ang+vectX)<MAX_NECK_ROT)&&((neck_rot_ang+vectX)>MIN_NECK_ROT)){
        neck_rot_ang=neck_rot_ang+vectX;
      }else{
        //Move body (in future)
      }
      if(((neck_updown_ang+vectY)<MAX_UPDOWN)&&((neck_updown_ang+vectY)>MIN_UPDOWN)){
         neck_updown_ang=neck_updown_ang+vectY;
      }    
  
      //Print debug informations
      rotNeck(neck_rot_ang);
      upDownNeck(neck_updown_ang);
      
      
      //Serial.println("Camera center:["+String(camCenX)+","+String(camCenY)+"]");
      //Serial.println("VectX: "+String(vectX) + " ,VectY: "+String(vectY));
      //Serial.println("Rotation angle: "+String(neck_rot_ang) + " ,UpDown angle: "+String(neck_updown_ang));
    }
    
  }         
}

void convertToVariablesINT(String datapack){
  datapack = datapack.substring(0, datapack.length() - 1);
  
  int comma1 = datapack.indexOf(',');
  int comma2 = datapack.indexOf(',', comma1 + 1);
  int comma3 = datapack.indexOf(',', comma2 + 1);
  
  camAX = datapack.substring(0, comma1).toInt();
  camAY = datapack.substring(comma1 + 1, comma2).toInt();
  camBX = datapack.substring(comma2 + 1, comma3).toInt();
  camBY = datapack.substring(comma3 + 1).toInt();

  //Serial.println(camAX);
  //Serial.println(camBX);
  //Serial.println(camAY);
  //Serial.println(camBY  );

  camCenX = int((camBX+camAX)/2);
  camCenY = int((camBY+camAY)/2);

  //Serial.println(camCenY);
}

void setDefaultPose(){
  neck_rot.write(80);
  neck_left.write(90); //90
  neck_right.write(100); //100
}

float rotNeck(float deg){
  float x_r=((deg+108)/0.8667);

  neck_rot.write(x_r);
}

float upDownNeck(float deg){
  float x_l=(((3*deg)+180)/2);
  float x_r=((deg-63.53)/(-0.7059));

  //Serial.println(x_l);
  //Serial.println(x_r);

  neck_left.write(x_l);
  neck_right.write(x_r);
}

//void startAnimationA(){
//  int timeToSleep=1000/FPSA;
//  for(int i=0;i <FRAMESA;i++){
//    neck_left.write(animAL[i]); 
//    neck_right.write(animAR[i]);
//    delay(timeToSleep); 
//  }
//}

void startAnimationB(){
  int timeToSleep=1000/FPSB;
  for(int i=0;i <FRAMESB;i++){
    neck_left.write(animBL[i]); 
    neck_right.write(animBR[i]);
    delay(timeToSleep); 
  }
}
